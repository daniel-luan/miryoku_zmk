// Copyright 2021 Manna Harbour
// https://github.com/manna-harbour/miryoku

#include "../miryoku/custom_config.h"
#include "../miryoku/mapping/64/helix.h"
#include "../miryoku/miryoku.dtsi"

&nice_view_spi {
    cs-gpios = <&pro_micro 10 GPIO_ACTIVE_HIGH>;
};